## Kconfig
```kconfig
DT_COMPAT_ZMK_BEHAVIOR_CYCLE_ANIMATION := zmk,behavior-cycle-animation
config ZMK_BEHAVIOR_CYCLE_ANIMATION
		bool
		default y
```

## app/dts/bindings/behaviors/zmk,behavior-cycle-animation.yaml
```yaml
# SPDX-License-Identifier: MIT

compatible: "zmk,behavior-cycle-animation"

include: one_param.yaml
```

## boards/shields/prototype_mk1/Kconfig.defconfig
```kconfig
# Copyright (c) 2020 Ryan Cross
# SPDX-License-Identifier: MIT


if SHIELD_PROTOTYPE_MK1_LEFT || SHIELD_PROTOTYPE_MK1_DONGLE

config ZMK_KEYBOARD_NAME
    default "Prototype_Mk1"

config ZMK_SPLIT_ROLE_CENTRAL
    default y

endif 



if SHIELD_PROTOTYPE_MK1_DONGLE

# Set this to ZMK_SPLIT_BLE_CENTRAL_PERIPHERALS + Profiles
config BT_MAX_CONN
    default 5

config BT_MAX_PAIRED
    default 5

config ZMK_SPLIT_BLE_CENTRAL_PERIPHERALS
    default 2

endif # SHIELD_PROTOTYPE_MK1_DONGLE



if SHIELD_PROTOTYPE_MK1_LEFT || SHIELD_PROTOTYPE_MK1_RIGHT || SHIELD_PROTOTYPE_MK1_DONGLE
config ZMK_SPLIT
    default y

if ZMK_DISPLAY
config I2C
    default y
config SSD1306
    default y
endif # ZMK_DISPLAY

if LVGL

if !SHIELD_PROTOTYPE_MK1_DONGLE
config LV_Z_VDB_SIZE
    default 64
endif

if SHIELD_PROTOTYPE_MK1_DONGLE
config LV_Z_VDB_SIZE
    default 64
choice ZMK_DISPLAY_WORK_QUEUE
    default ZMK_DISPLAY_WORK_QUEUE_DEDICATED
endchoice
endif

config LV_DPI_DEF
    default 148

config LV_Z_BITS_PER_PIXEL
    default 1

choice LV_COLOR_DEPTH
    default LV_COLOR_DEPTH_1
endchoice

endif # LVGL


if ZMK_BACKLIGHT
config PWM
    default y
config LED_PWM
    default y
endif

endif
```

## boards/shields/prototype_mk1/Kconfig.shield
```kconfig
# Copyright (c) 2020 Ryan Cross
# SPDX-License-Identifier: MIT

config SHIELD_PROTOTYPE_MK1_LEFT
    def_bool $(shields_list_contains,prototype_mk1_left)

config SHIELD_PROTOTYPE_MK1_RIGHT
    def_bool $(shields_list_contains,prototype_mk1_right)

config SHIELD_PROTOTYPE_MK1_DONGLE
    def_bool $(shields_list_contains,prototype_mk1_dongle)
```

## dts/bindings/behaviors/zmk,behavior-cycle-animation.yaml
```yaml
# SPDX-License-Identifier: MIT

compatible: "zmk,behavior-cycle-animation"

description: |
  Behavior that controls Nice!View theme and animation:
  - Toggle animation
  - Turn animation ON
  - Turn animation OFF
  - Cycle to next Nice!View theme

include: 
  - base-behavior.yaml

properties:
  "#binding-cells":
    const: 1
```
