#include <dt-bindings/zmk/behaviors.h>
#include <dt-bindings/zmk/keys.h>

/ {
    behaviors {
       /omit-if-no-ref/ nvc: nvc {
            compatible = "zmk,behavior-cycle-animation";
            #binding-cells = <1>;
        };
    };
};