/*
 * Nice!View theme cycle behavior
 */

#include <dt-bindings/zmk/behaviors.h>

/ {
    behaviors {
        nice_view_theme: nice_view_theme {
            compatible = "zmk,behavior-nice-view-theme";
            #binding-cells = <0>;
            display-name = "Nice!View Theme";
        };
    };
};